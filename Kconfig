## Kconfig
```kconfig
mainmenu "AurixOS Kconfig configuration"

source "kernel/Kconfig"
source "modules/Kconfig"
```

## kernel/Kconfig
```kconfig
menu "Processor settings"

config CPU_MAX_COUNT
    int "Maximum amount of CPUs"
    default 64

config IRQ_MAX_CALLBACKS
    int "Maximum amount of callbacks to be assigned to an IRQ"
    default 4

source "kernel/arch/$(ARCH)/Kconfig"

endmenu

menu "Kernel hacking"

config BUILD_TESTS
    bool "Build tests"
    default false
    help
    This includes a test suite for internal kernel components in the build. To run these tests, see the documentation.

config KSH
    bool "Enable debug shell"
    default false
    help
    Adds a kernel debug shell if init fails

config MPANIC_DUMP
    bool "Enable module panic dump"
    default false
    help
    Enable register dump to stdout on module panic (exec, kmod)

endmenu
```

## kernel/arch/x86_64/Kconfig
```kconfig
config IOAPIC_MAX_COUNT
    int "Maximum amount of I/O APIC controllers"
    default 4
```

## modules/pci/Kconfig
```kconfig
menu "PCI"

config PCI_MAX_DEVICES
    int "Maximum amount of PCI devices"
    default 32

endmenu
```

## utils/arch/x86_64/defconfig
```kconfig
#
# Processor settings
#
CONFIG_CPU_MAX_COUNT=64
CONFIG_IRQ_MAX_CALLBACKS=4
CONFIG_IOAPIC_MAX_COUNT=4
# end of Processor settings

#
# Kernel hacking
#
# CONFIG_BUILD_TESTS is not set
CONFIG_KSH=n
# CONFIG_MPANIC_DUMP is not set
# end of Kernel hacking

#
# Kernel Modules
#

#
# PCI
#
CONFIG_PCI_MAX_DEVICES=32
# end of PCI
# end of Kernel Modules
```
